// ZMK Core Includes
#include <behaviors.dtsi>
#include <dt-bindings/zmk/bt.h>
#include <behaviors/num_word.dtsi> // requires https://github.com/urob/zmk-auto-layer module
#include <dt-bindings/zmk/keys.h>
#include <dt-bindings/zmk/bt.h>
#include <dt-bindings/zmk/mouse.h>
#include <dt-bindings/zmk/outputs.h>
#include <dt-bindings/zmk/rgb.h>
#include <input/processors.dtsi>
#include "zmk-helpers/helper.h"
#include "zmk-helpers/key-labels/eyelash42.h"

// Layers
#define L1 0
#define L2 1
#define Fn 2

// Meh key
#define MEH LS(LC(LALT))

// Behaviors Constants
#define TAPPING_TERM_MS 280
#define QUICK_TAP_MS 175
#define REQUIRE_PRIOR_IDLE_MS 150

// Combos Constants
#define COMBO_TERM_DEFAULT 30
#define COMBO_QUICK_TAP_MS 100

// Key positions per hand
#define KEYS_L LT0 LT1 LT2 LT3 LT4 LM0 LM1 LM2 LM3 LM4 LB0 LB1 LB2 LB3 LB4
#define KEYS_R RT0 RT1 RT2 RT3 RT4 RM0 RM1 RM2 RM3 RM4 RB0 RB1 RB2 RB3 RB4
#define THUMBS LH2 LH1 LH0 RH0 RH1 RH2


#include "behaviors.dtsi"
#include "macros.dtsi"
#include "combos.dtsi"

// Alpha layer: uncomment desired, comment the others
#include "L1_colemak-dh.dtsi"
// #include "L1_colemak.dtsi"
// #include "L1_dvorak.dtsi"
// #include "L1_qwerty.dtsi"

// Other layers
#include "L2.dtsi"
#include "Fn.dtsi"

